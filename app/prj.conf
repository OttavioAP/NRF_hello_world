## CMakeLists.txt
```
cmake_minimum_required(VERSION 3.20.0)

find_package(Zephyr REQUIRED HINTS $ENV{ZEPHYR_BASE})
project(nrf52840_hello)

target_sources(app PRIVATE src/main.c)
```

## prj.conf
```kconfig
# Enable GPIO for LED control
CONFIG_GPIO=y

# Optional: keep printk available for basic status output
CONFIG_PRINTK=y
```

## boards/nrf52840dk_nrf52840.overlay
```dts
/*
 * Board overlay placeholder.
 * The nRF52840 DK already defines led0/led1 aliases.
 */
```

## src/main.c
```c
/*
 * Simple LED blink example for nRF52840 DK using Zephyr.
 */

#include <zephyr/kernel.h>
#include <zephyr/device.h>
#include <zephyr/devicetree.h>
#include <zephyr/drivers/gpio.h>
#include <zephyr/sys/printk.h>

#define LED0_NODE DT_ALIAS(led0)

#if !DT_NODE_HAS_STATUS(LED0_NODE, okay)
#error "LED0 alias not defined in the device tree"
#endif

static const struct gpio_dt_spec led = GPIO_DT_SPEC_GET(LED0_NODE, gpios);

int main(void)
{
	int ret;

	if (!device_is_ready(led.port)) {
		printk("LED device not ready\n");
		return 0;
	}

	ret = gpio_pin_configure_dt(&led, GPIO_OUTPUT_INACTIVE);
	if (ret != 0) {
		printk("Failed to configure LED pin (err %d)\n", ret);
		return 0;
	}

	while (1) {
		gpio_pin_toggle_dt(&led);
		k_msleep(500);
	}

	return 0;
}
```
