## west.yml
```yaml
manifest:
  version: "0.10"
  defaults:
    remote: zephyrproject
  remotes:
    - name: zephyrproject
      url-base: https://github.com/zephyrproject-rtos
  projects:
    - name: zephyr
      repo-path: zephyr
      revision: v3.6.0
      import:
        name-allowlist:
          - cmsis
          - hal_nordic
  self:
    path: app
```
